## conf/machine/cl-som-imx7.conf
```bitbake
#@TYPE: Machine
#@NAME: CompuLab CL-SOM-iMX7
#@SOC: i.MX7D
#@DESCRIPTION: Machine configuration for CompuLab CL-SOM-iMX7 machines
#@MAINTAINER: Ilya Ledvich <ilya@compulab.co.il>

include conf/machine/include/imx-base.inc
include conf/machine/include/tune-cortexa7.inc

SOC_FAMILY = "mx7:mx7d"
MACHINEOVERRIDES =. "mx7:mx7d:"

PREFERRED_PROVIDER_u_boot_cl-som-imx7 = "u-boot-compulab"
PREFERRED_PROVIDER_virtual/bootloader_cl-som-imx7 = "u-boot-compulab"
PREFERRED_PROVIDER_virtual/kernel_cl-som-imx7 = "linux-compulab"

UBOOT_MACHINE ?= "cl_som_imx7_defconfig"

IMAGE_FSTYPES = "tar.bz2 ext4 sdcard"

KERNEL_DEVICETREE = "imx7d-cl-som-imx7-m4.dtb imx7d-cl-som-imx7.dtb imx7d-sbc-imx7-csi.dtb imx7d-sbc-imx7-lvds.dtb imx7d-sbc-imx7-m4.dtb imx7d-sbc-imx7.dtb \
			imx7d-sbc-iot-imx7-can.dtb imx7d-sbc-iot-imx7-rs485-hdx.dtb imx7d-sbc-iot-imx7.dtb imx7d-sbc-ucm-imx7.dtb imx7d-ucm-imx7.dtb"

MACHINE_FEATURES += "alsa bluetooth serial usbhost wifi pci"

XSERVER += "mesa-driver-swrast"

MACHINE_FIRMWARE = "linux-firmware-wl18xx \
			linux-firmware-iwlwifi-6000g2a-5 linux-firmware-iwlwifi-6000g2a-6 \
			linux-firmware-iwlwifi-6000g2b-5 linux-firmware-iwlwifi-6000g2b-6 \
			linux-firmware-iwlwifi-7260 \
			firmware-imx-brcm"

SERIAL_CONSOLE = "115200 ttymxc0"
```
